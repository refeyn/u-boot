## board/refeyn/aquila-am69-refeyn/Kconfig
```kconfig
# SPDX-License-Identifier: GPL-2.0-only
#
# Copyright 2024 Toradex
# Copyright 2025 Refeyn
#

if TARGET_AQUILA_AM69_A72_REFEYN

config SYS_BOARD
	default "aquila-am69-refeyn"

config SYS_VENDOR
	default "refeyn"

config SYS_CONFIG_NAME
	default "aquila-am69-refeyn"

config TDX_CFG_BLOCK
	default y

config TDX_CFG_BLOCK_2ND_ETHADDR
	default y

config TDX_CFG_BLOCK_DEV
	default "0"

config TDX_CFG_BLOCK_EXTRA
	default y

config TDX_CFG_BLOCK_OFFSET
	default "-512"

config TDX_CFG_BLOCK_PART
	default "1"

config TDX_HAVE_EEPROM_EXTRA
	default y

config TDX_HAVE_MMC
	default y

source "board/toradex/common/Kconfig"

endif

if TARGET_AQUILA_AM69_R5_REFEYN

config SYS_BOARD
	default "aquila-am69-refeyn"

config SYS_VENDOR
	default "refeyn"

config SYS_CONFIG_NAME
	default "aquila-am69-refeyn"

config SPL_LDSCRIPT
	default "arch/arm/mach-omap2/u-boot-spl.lds"

endif
```

## board/refeyn/imx8qm_ec_asm_00014_01/Kconfig
```kconfig
if TARGET_IMX8QM_EC_ASM_00014_01

config SYS_BOARD
	default "imx8qm_ec_asm_00014_01"

config SYS_VENDOR
	default "refeyn"

config SYS_CONFIG_NAME
	default "imx8qm_ec_asm_00014_01"

config IMX_CONFIG
	default "board/refeyn/imx8qm_ec_asm_00014_01/imximage.cfg"

source "board/freescale/common/Kconfig"

endif
```
